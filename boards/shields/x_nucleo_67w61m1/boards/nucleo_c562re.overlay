/*
 * Copyright (c) 2026 STMicroelectronics
 *
 * SPDX-License-Identifier: Apache-2.0
 */

&arduino_spi {
	dmas = <&lpdma1 0 5 0>,
	       <&lpdma1 1 4 0>;
	dma-names = "tx", "rx";
};

&lpdma1 {
	status = "okay";
};
