## drivers/audio/Kconfig.wm8994
```kconfig
# Copyright (c) 2026 STMicroelectronics
# SPDX-License-Identifier: Apache-2.0

config AUDIO_CODEC_WM8994
	bool "Wolfson WM8994 codec support"
	default y
	select I2C
	depends on DT_HAS_WOLFSON_WM8994_ENABLED
	help
	  Enable support for the Wolfson WM8994 codec
```

## drivers/sensor/st/ism330dlc/Kconfig
```kconfig
# Copyright (c) 2026
# SPDX-License-Identifier: Apache-2.0

config ISM330DLC
	bool "ISM330DLC I2C accelerometer and gyroscope"
	default y
	depends on DT_HAS_ST_ISM330DLC_ENABLED
	depends on ZEPHYR_HAL_ST_MODULE
	select I2C
	select HAS_STMEMSC
	select USE_STDC_ISM330DLC
	help
	  Enable polling support for the ISM330DLC accelerometer and gyroscope.
	  Both sensors run at 104 Hz, with fixed ranges of +/-2 g and
	  +/-250 degrees/second. FIFO, interrupts and runtime configuration
	  are not supported.
```

## dts/bindings/audio/wolfson,wm8994.yaml
```yaml
# SPDX-FileCopyrightText: Copyright The Zephyr Project Contributors
# SPDX-License-Identifier: Apache-2.0

description: Wolfson Microelectronics WM8994 Audio CODEC

include: i2c-device.yaml

compatible: "wolfson,wm8994"

properties:
  reg:
    required: true

  mclk-frequency:
    type: int
    default: 12288000
    description: External MCLK frequency in Hz.

  clock-source:
    type: string
    default: "MCLK1"
    description: |
      Codec clock source used for AIF1CLK.
    enum:
      - "MCLK1"
      - "MCLK2"
      - "FLL1"
      - "FLL2"
```

## dts/bindings/sensor/st,ism330dlc-i2c.yaml
```yaml
# Copyright (c) 2026
# SPDX-License-Identifier: Apache-2.0

description: |
  STMicroelectronics ISM330DLC 6-axis IMU accessed through I2C.
  The driver supports polling acceleration and angular velocity at 104 Hz
  with fixed full-scale ranges of +/-2 g and +/-250 degrees/second.

compatible: "st,ism330dlc"

include: ["sensor-device.yaml", "i2c-device.yaml"]
```
