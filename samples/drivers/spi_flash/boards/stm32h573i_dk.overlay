/*
 * Copyright (c) 2024 STMicroelectronics
 *
 * SPDX-License-Identifier: Apache-2.0
 */

&xspi1 {
	/* request 57 for XSPI1 */
	dmas = <&gpdma1 4 57 0>,
	       <&gpdma1 5 57 0>;
	dma-names = "tx", "rx";
};

&gpdma1 {
	status = "okay";
};
