/*
 * Copyright (c) 2025 STMicroelectronics
 *
 * SPDX-License-Identifier: Apache-2.0
 */

dut: &usart1 {
	dmas = <&dma2 6 2 STM32_DMA_PRIORITY_HIGH>,
	       <&dma2 7 2 STM32_DMA_PRIORITY_HIGH>;
	dma-names = "tx", "rx";
};

&dma2 {
	status = "okay";
};
