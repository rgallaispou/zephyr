/*
 * Copyright (c) 2025 STMicroelectronics
 *
 * SPDX-License-Identifier: Apache-2.0
 */

dut: &usart2 {
	dmas = <&dma1 7 STM32_DMA_PRIORITY_HIGH>,
	       <&dma1 6 STM32_DMA_PRIORITY_HIGH>;
	dma-names = "tx", "rx";
	status = "okay";
};
