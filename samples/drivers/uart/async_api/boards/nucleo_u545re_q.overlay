/*
 * SPDX-License-Identifier: Apache-2.0
 *
 * Copyright (c) 2026 Smile
 */

&usart1 {
	dmas = <&gpdma1 0 25 0>,
	       <&gpdma1 1 24 0>;
	dma-names = "tx", "rx";
};

&gpdma1 {
	status = "okay";
};
