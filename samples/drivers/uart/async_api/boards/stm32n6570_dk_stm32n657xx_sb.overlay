/*
 * Copyright (c) 2025 STMicroelectronics
 *
 * SPDX-License-Identifier: Apache-2.0
 */

&usart1 {
	dmas = <&gpdma1 0 108 0>,
	       <&gpdma1 1 107 0>;
	dma-names = "tx", "rx";
};

&gpdma1 {
	status = "okay";
};
