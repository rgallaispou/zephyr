/*
 * SPDX-License-Identifier: Apache-2.0
 */

/* console UART */
&usart3 {
	dmas = <&dmamux1 2 46 0>,
	       <&dmamux1 3 45 0>;
	dma-names = "tx", "rx";
	status = "okay";
};

&dma1 {
	status = "okay";
};

&dma2 {
	status = "okay";
};

&dmamux1 {
	status = "okay";
};
